## Documentation/devicetree/bindings/mmc/snps,dwcmshc-sdhci.yaml
```yaml
# SPDX-License-Identifier: GPL-2.0-only
%YAML 1.2
---
$id: http://devicetree.org/schemas/mmc/snps,dwcmshc-sdhci.yaml#
$schema: http://devicetree.org/meta-schemas/core.yaml#

title: Synopsys Designware Mobile Storage Host Controller

maintainers:
  - Ulf Hansson <ulf.hansson@linaro.org>
  - Jisheng Zhang <Jisheng.Zhang@synaptics.com>

properties:
  compatible:
    oneOf:
      - items:
          - enum:
              - rockchip,rk3528-dwcmshc
              - rockchip,rk3562-dwcmshc
              - rockchip,rk3576-dwcmshc
          - const: rockchip,rk3588-dwcmshc
      - items:
          - const: sophgo,sg2044-dwcmshc
          - const: sophgo,sg2042-dwcmshc
      - enum:
          - rockchip,rk3568-dwcmshc
          - rockchip,rk3588-dwcmshc
          - snps,dwcmshc-sdhci
          - sophgo,cv1800b-dwcmshc
          - sophgo,sg2002-dwcmshc
          - sophgo,sg2042-dwcmshc
          - thead,th1520-dwcmshc
          - eswin,eic7700-dwcmshc

  reg:
    maxItems: 1

  interrupts:
    maxItems: 1

  clocks:
    minItems: 1
    maxItems: 5

  clock-names:
    minItems: 1
    maxItems: 5

  power-domains:
    maxItems: 1

  resets:
    maxItems: 5

  reset-names:
    maxItems: 5

  rockchip,txclk-tapnum:
    description: Specify the number of delay for tx sampling.
    $ref: /schemas/types.yaml#/definitions/uint8

  clock-output-names:
    maxItems: 1
    description:
      The name of the clock output representing the card clock,
      consumed by the PHY.

  '#clock-cells':
    enum: [0]
    description:
      Specifies how many cells are used when referencing the exported clock
      from another node. This property indicates that the clock output has
      no extra parameters and represents the card clock.

  eswin,hsp-sp-csr:
    $ref: /schemas/types.yaml#/definitions/phandle-array
    items:
      - description: Phandle to HSP(High-Speed Peripheral) device
      - description: Offset of internal status register for
                     internal clock
      - description: Offset of power control register for the power
    description: |
      A phandle to hsp-sp-csr with two arguments that configure
      HSP(High-Speed Peripheral) device. The argument one is the
      offset of internal status register for internal clocks,
      the argument two is offset of power control register for
      the power.

  eswin,syscrg-csr:
    $ref: /schemas/types.yaml#/definitions/phandle-array
    items:
      - description:
          Phandle to system CRG(System Clock and Reset Generator)
          device
      - description: Offset of core clock control register
    description: |
      A phandle to syscrg-csr with one arguments that configure
      CRG(System Clock and Reset Generator) device. The argument
      one is the offset of core clock control register

  drive-impedance-ohm:
    description: PHY drive impedance in ohms
    enum: [33, 40, 50, 66, 100]

required:
  - compatible
  - reg
  - interrupts
  - clocks
  - clock-names

allOf:
  - $ref: mmc-controller.yaml#

  - if:
      properties:
        compatible:
          contains:
            const: sophgo,sg2042-dwcmshc

    then:
      properties:
        clocks:
          items:
            - description: core clock
            - description: bus clock
            - description: timer clock
        clock-names:
          items:
            - const: core
            - const: bus
            - const: timer
    else:
      properties:
        clocks:
          minItems: 1
          items:
            - description: core clock
            - description: bus clock for optional
            - description: axi clock for rockchip specified
            - description: block clock for rockchip specified
            - description: timer clock for rockchip specified
        clock-names:
          minItems: 1
          items:
            - const: core
            - const: bus
            - const: axi
            - const: block
            - const: timer

  - if:
      properties:
        compatible:
          contains:
            const: eswin,eic7700-dwcmshc
    then:
      properties:
        resets:
          minItems: 4
          maxItems: 4
        reset-names:
          items:
            - const: txrx_rst
            - const: phy_rst
            - const: prstn
            - const: arstn
      required:
        - eswin,hsp-sp-csr
        - eswin,syscrg-csr
        - drive-impedance-ohm
    else:
      properties:
        resets:
          maxItems: 5
        reset-names:
          items:
            - const: core
            - const: bus
            - const: axi
            - const: block
            - const: timer

  - if:
      properties:
        compatible:
          contains:
            const: rockchip,rk3576-dwcmshc

    then:
      required:
        - power-domains

unevaluatedProperties: false

examples:
  - |
    mmc@fe310000 {
      compatible = "rockchip,rk3568-dwcmshc";
      reg = <0xfe310000 0x10000>;
      interrupts = <0 25 0x4>;
      clocks = <&cru 17>, <&cru 18>, <&cru 19>, <&cru 20>, <&cru 21>;
      clock-names = "core", "bus", "axi", "block", "timer";
      bus-width = <8>;
      #address-cells = <1>;
      #size-cells = <0>;
    };
  - |
    mmc@aa0000 {
      compatible = "snps,dwcmshc-sdhci";
      reg = <0xaa000 0x1000>;
      interrupts = <0 25 0x4>;
      clocks = <&cru 17>, <&cru 18>;
      clock-names = "core", "bus";
      bus-width = <8>;
      #address-cells = <1>;
      #size-cells = <0>;
    };

...
```
